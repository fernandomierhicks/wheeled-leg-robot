// Generated by protocol/generate_protocol.py from protocol/schema.json. DO NOT EDIT.
// Generated Param rows; included inside g_params[].
{.id = PARAM_IMU_ENABLE, .group_id = GROUP_SYSTEM, .name = "imu_enable", .value = 1.0f, .min_val = 0.0f, .max_val = 1.0f, .flags = PARAM_FLAG_PERSISTENT, .on_change = nullptr},
{.id = PARAM_BUZZER_VOLUME, .group_id = GROUP_SYSTEM, .name = "buzzer_volume", .value = 1.0f, .min_val = 0.0f, .max_val = 1.0f, .flags = PARAM_FLAG_PERSISTENT, .on_change = nullptr},
{.id = PARAM_LED_ENABLE, .group_id = GROUP_SYSTEM, .name = "led_enable", .value = 1.0f, .min_val = 0.0f, .max_val = 1.0f, .flags = PARAM_FLAG_PERSISTENT, .on_change = nullptr},
{.id = PARAM_HIP_L_ENABLE, .group_id = GROUP_SYSTEM, .name = "hip_l_enable", .value = 0.0f, .min_val = 0.0f, .max_val = 1.0f, .flags = PARAM_FLAG_PERSISTENT, .on_change = nullptr},
{.id = PARAM_HIP_R_ENABLE, .group_id = GROUP_SYSTEM, .name = "hip_r_enable", .value = 0.0f, .min_val = 0.0f, .max_val = 1.0f, .flags = PARAM_FLAG_PERSISTENT, .on_change = nullptr},
{.id = PARAM_WHEEL_L_ENABLE, .group_id = GROUP_SYSTEM, .name = "wheel_l_enable", .value = 1.0f, .min_val = 0.0f, .max_val = 1.0f, .flags = PARAM_FLAG_PERSISTENT, .on_change = nullptr},
{.id = PARAM_WHEEL_R_ENABLE, .group_id = GROUP_SYSTEM, .name = "wheel_r_enable", .value = 1.0f, .min_val = 0.0f, .max_val = 1.0f, .flags = PARAM_FLAG_PERSISTENT, .on_change = nullptr},
{.id = PARAM_WATCHDOG_ENABLE, .group_id = GROUP_SYSTEM, .name = "watchdog_enable", .value = 0.0f, .min_val = 0.0f, .max_val = 1.0f, .flags = PARAM_FLAG_PERSISTENT, .on_change = nullptr},
{.id = PARAM_LOOP_PROFILE_ENABLE, .group_id = GROUP_SYSTEM, .name = "loop_profile_enable", .value = 0.0f, .min_val = 0.0f, .max_val = 1.0f, .flags = 0, .on_change = nullptr},
{.id = PARAM_HIP_RUNNING_KP, .group_id = GROUP_HIP, .name = "hip_running_kp", .value = 5.0f, .min_val = 0.0f, .max_val = 100.0f, .flags = PARAM_FLAG_PERSISTENT, .on_change = nullptr},
{.id = PARAM_HIP_RUNNING_KD, .group_id = GROUP_HIP, .name = "hip_running_kd", .value = 0.5f, .min_val = 0.0f, .max_val = 5.0f, .flags = PARAM_FLAG_PERSISTENT, .on_change = nullptr},
{.id = PARAM_HIP_RUNNING_TFF, .group_id = GROUP_HIP, .name = "hip_running_tff", .value = 0.0f, .min_val = -5.0f, .max_val = 5.0f, .flags = PARAM_FLAG_PERSISTENT, .on_change = nullptr},
{.id = PARAM_HIP_RUNNING_RAMP_TIME_S, .group_id = GROUP_HIP, .name = "hip_running_ramp_s", .value = 2.0f, .min_val = 0.0f, .max_val = 10.0f, .flags = PARAM_FLAG_PERSISTENT, .on_change = nullptr},
{.id = PARAM_ESTOP_HIP_DISABLE, .group_id = GROUP_HIP, .name = "estop_hip_disable", .value = 1.0f, .min_val = 0.0f, .max_val = 1.0f, .flags = PARAM_FLAG_PERSISTENT, .on_change = nullptr},
{.id = PARAM_CALIB_SEEK_SPEED, .group_id = GROUP_CALIB, .name = "calib_seek_speed", .value = 0.17453f, .min_val = 0.01f, .max_val = 0.5f, .flags = PARAM_FLAG_PERSISTENT, .on_change = nullptr},
{.id = PARAM_CALIB_MOVE_SPEED, .group_id = GROUP_CALIB, .name = "calib_move_speed", .value = 0.174533f, .min_val = 0.01f, .max_val = 0.5f, .flags = PARAM_FLAG_PERSISTENT, .on_change = nullptr},
{.id = PARAM_CALIB_SEEK_KP, .group_id = GROUP_CALIB, .name = "calib_seek_kp", .value = 16.0f, .min_val = 0.1f, .max_val = 100.0f, .flags = PARAM_FLAG_PERSISTENT, .on_change = nullptr},
{.id = PARAM_CALIB_KD, .group_id = GROUP_CALIB, .name = "calib_kd", .value = 0.05f, .min_val = 0.0f, .max_val = 5.0f, .flags = PARAM_FLAG_PERSISTENT, .on_change = nullptr},
{.id = PARAM_CALIB_SEEK_CURRENT_LIMIT_A, .group_id = GROUP_CALIB, .name = "calib_seek_cur_lim", .value = 0.75f, .min_val = 0.2f, .max_val = 5.0f, .flags = PARAM_FLAG_PERSISTENT, .on_change = nullptr},
{.id = PARAM_CALIB_MOVE_CURRENT_LIMIT_A, .group_id = GROUP_CALIB, .name = "calib_move_cur_lim", .value = 1.5f, .min_val = 0.2f, .max_val = 10.0f, .flags = PARAM_FLAG_PERSISTENT, .on_change = nullptr},
{.id = PARAM_CALIB_BACKOFF_RAD, .group_id = GROUP_CALIB, .name = "calib_backoff_rad", .value = 0.0872665f, .min_val = 0.01f, .max_val = 0.35f, .flags = PARAM_FLAG_PERSISTENT, .on_change = nullptr},
{.id = PARAM_CALIB_RANGE_L_RAD, .group_id = GROUP_CALIB, .name = "calib_range_l_rad", .value = 1.5708f, .min_val = 0.1f, .max_val = 3.14159f, .flags = PARAM_FLAG_PERSISTENT, .on_change = nullptr},
{.id = PARAM_CALIB_RANGE_R_RAD, .group_id = GROUP_CALIB, .name = "calib_range_r_rad", .value = 1.5708f, .min_val = 0.1f, .max_val = 3.14159f, .flags = PARAM_FLAG_PERSISTENT, .on_change = nullptr},
{.id = PARAM_CALIB_SEEK_TIMEOUT_S, .group_id = GROUP_CALIB, .name = "calib_seek_timeout", .value = 30.0f, .min_val = 1.0f, .max_val = 60.0f, .flags = PARAM_FLAG_PERSISTENT, .on_change = nullptr},
{.id = PARAM_CALIB_RELEASE_TIMEOUT_S, .group_id = GROUP_CALIB, .name = "calib_release_to", .value = 5.0f, .min_val = 0.5f, .max_val = 30.0f, .flags = PARAM_FLAG_PERSISTENT, .on_change = nullptr},
{.id = PARAM_CALIB_MAX_SEEK_TRAVEL_RAD, .group_id = GROUP_CALIB, .name = "calib_max_seek_rad", .value = 2.0f, .min_val = 0.1f, .max_val = 6.28319f, .flags = PARAM_FLAG_PERSISTENT, .on_change = nullptr},
{.id = PARAM_CALIB_MAX_RELEASE_TRAVEL_RAD, .group_id = GROUP_CALIB, .name = "calib_max_rel_rad", .value = 0.5f, .min_val = 0.05f, .max_val = 1.5708f, .flags = PARAM_FLAG_PERSISTENT, .on_change = nullptr},
{.id = PARAM_CALIB_CURRENT_TRIP_MS, .group_id = GROUP_CALIB, .name = "calib_cur_trip_ms", .value = 50.0f, .min_val = 0.0f, .max_val = 500.0f, .flags = PARAM_FLAG_PERSISTENT, .on_change = nullptr},
{.id = PARAM_CALIB_MOVE_KP, .group_id = GROUP_CALIB, .name = "calib_move_kp", .value = 32.0f, .min_val = 0.1f, .max_val = 100.0f, .flags = PARAM_FLAG_PERSISTENT, .on_change = nullptr},
{.id = PARAM_CALIB_RAMPDOWN_TIME_S, .group_id = GROUP_CALIB, .name = "calib_rampdown_s", .value = 2.0f, .min_val = 0.0f, .max_val = 10.0f, .flags = PARAM_FLAG_PERSISTENT, .on_change = nullptr},
{.id = PARAM_CALIB_BYPASS_EN, .group_id = GROUP_CALIB, .name = "calib_bypass_en", .value = 0.0f, .min_val = 0.0f, .max_val = 1.0f, .flags = PARAM_FLAG_PERSISTENT, .on_change = nullptr},
{.id = PARAM_WM_ENC_TIMEOUT_MS, .group_id = GROUP_WHEEL, .name = "wm_enc_timeout_ms", .value = 20.0f, .min_val = 5.0f, .max_val = 500.0f, .flags = PARAM_FLAG_PERSISTENT, .on_change = nullptr},
{.id = PARAM_LQR_ENABLE, .group_id = GROUP_CONTROL, .name = "lqr_enable", .value = 1.0f, .min_val = 0.0f, .max_val = 1.0f, .flags = PARAM_FLAG_PERSISTENT, .on_change = nullptr},
{.id = PARAM_SIM_PITCH_RAD, .group_id = GROUP_CONTROL, .name = "sim_pitch_rad", .value = 0.0f, .min_val = -1.5708f, .max_val = 1.5708f, .flags = 0, .on_change = nullptr},
{.id = PARAM_LQR_TORQUE_LIMIT, .group_id = GROUP_CONTROL, .name = "lqr_torque_limit", .value = 0.1f, .min_val = 0.0f, .max_val = 7.0f, .flags = PARAM_FLAG_READONLY|PARAM_FLAG_COMMAND, .on_change = nullptr},
{.id = PARAM_WHEEL_VEL_LIMIT_TURNS_S, .group_id = GROUP_CONTROL, .name = "wm_vel_limit", .value = 3.0f, .min_val = 1.0f, .max_val = 20.0f, .flags = PARAM_FLAG_PERSISTENT, .on_change = nullptr},
{.id = PARAM_VEL_PI_EN, .group_id = GROUP_CONTROL, .name = "vel_pi_en", .value = 1.0f, .min_val = 0.0f, .max_val = 1.0f, .flags = PARAM_FLAG_PERSISTENT, .on_change = nullptr},
{.id = PARAM_VEL_PI_KP, .group_id = GROUP_CONTROL, .name = "vel_pi_kp", .value = 0.2f, .min_val = 0.0f, .max_val = 5.0f, .flags = PARAM_FLAG_PERSISTENT, .on_change = nullptr},
{.id = PARAM_VEL_PI_KI, .group_id = GROUP_CONTROL, .name = "vel_pi_ki", .value = 0.1f, .min_val = 0.0f, .max_val = 5.0f, .flags = PARAM_FLAG_PERSISTENT, .on_change = nullptr},
{.id = PARAM_VEL_PI_KFF, .group_id = GROUP_CONTROL, .name = "vel_pi_kff", .value = 0.1049f, .min_val = 0.0f, .max_val = 1.0f, .flags = PARAM_FLAG_PERSISTENT, .on_change = nullptr},
{.id = PARAM_VEL_PI_RATE_LIM, .group_id = GROUP_CONTROL, .name = "vel_pi_rate_lim", .value = 1.745f, .min_val = 0.1f, .max_val = 10.0f, .flags = PARAM_FLAG_PERSISTENT, .on_change = nullptr},
{.id = PARAM_VEL_PI_INT_MAX, .group_id = GROUP_CONTROL, .name = "vel_pi_int_max", .value = 1.0f, .min_val = 0.1f, .max_val = 5.0f, .flags = PARAM_FLAG_PERSISTENT, .on_change = nullptr},
{.id = PARAM_V_CMD_MS, .group_id = GROUP_CONTROL, .name = "v_cmd_ms", .value = 0.0f, .min_val = -2.0f, .max_val = 2.0f, .flags = PARAM_FLAG_COMMAND, .on_change = nullptr},
{.id = PARAM_YAW_PI_EN, .group_id = GROUP_CONTROL, .name = "yaw_pi_en", .value = 1.0f, .min_val = 0.0f, .max_val = 1.0f, .flags = PARAM_FLAG_PERSISTENT, .on_change = nullptr},
{.id = PARAM_YAW_PI_KP, .group_id = GROUP_CONTROL, .name = "yaw_pi_kp", .value = 0.2f, .min_val = 0.0f, .max_val = 5.0f, .flags = PARAM_FLAG_PERSISTENT, .on_change = nullptr},
{.id = PARAM_YAW_PI_KI, .group_id = GROUP_CONTROL, .name = "yaw_pi_ki", .value = 0.1f, .min_val = 0.0f, .max_val = 5.0f, .flags = PARAM_FLAG_PERSISTENT, .on_change = nullptr},
{.id = PARAM_YAW_PI_TORQUE_MAX, .group_id = GROUP_CONTROL, .name = "yaw_pi_torque_max", .value = 0.2f, .min_val = 0.0f, .max_val = 3.0f, .flags = PARAM_FLAG_PERSISTENT, .on_change = nullptr},
{.id = PARAM_YAW_PI_INT_MAX, .group_id = GROUP_CONTROL, .name = "yaw_pi_int_max", .value = 0.5f, .min_val = 0.0f, .max_val = 3.0f, .flags = PARAM_FLAG_PERSISTENT, .on_change = nullptr},
{.id = PARAM_OMEGA_CMD_RDS, .group_id = GROUP_CONTROL, .name = "omega_cmd_rds", .value = 0.0f, .min_val = -4.0f, .max_val = 4.0f, .flags = PARAM_FLAG_COMMAND, .on_change = nullptr},
{.id = PARAM_FF1_ALPHA, .group_id = GROUP_CONTROL, .name = "ff1_alpha", .value = 0.0f, .min_val = 0.0f, .max_val = 1.0f, .flags = 0, .on_change = nullptr},
{.id = PARAM_FF2_ALPHA, .group_id = GROUP_CONTROL, .name = "ff2_alpha", .value = 0.0f, .min_val = 0.0f, .max_val = 1.0f, .flags = 0, .on_change = nullptr},
{.id = PARAM_FF1_KT_HIP, .group_id = GROUP_CONTROL, .name = "ff1_kt_hip", .value = 1.2732f, .min_val = 0.0f, .max_val = 5.0f, .flags = PARAM_FLAG_READONLY, .on_change = nullptr},
{.id = PARAM_JUMP_ENABLE, .group_id = GROUP_CONTROL, .name = "jump_enable", .value = 0.0f, .min_val = 0.0f, .max_val = 1.0f, .flags = PARAM_FLAG_PERSISTENT, .on_change = nullptr},
{.id = PARAM_JUMP_TORQUE_MAX, .group_id = GROUP_CONTROL, .name = "jump_torque_max", .value = 0.0f, .min_val = 0.0f, .max_val = 18.0f, .flags = PARAM_FLAG_PERSISTENT, .on_change = nullptr},
{.id = PARAM_JUMP_CROUCH_TIME_S, .group_id = GROUP_CONTROL, .name = "jump_crouch_time", .value = 0.3f, .min_val = 0.05f, .max_val = 1.0f, .flags = PARAM_FLAG_PERSISTENT, .on_change = nullptr},
{.id = PARAM_JUMP_RAMP_UP_S, .group_id = GROUP_CONTROL, .name = "jump_ramp_up", .value = 0.05f, .min_val = 0.005f, .max_val = 0.5f, .flags = PARAM_FLAG_PERSISTENT, .on_change = nullptr},
{.id = PARAM_JUMP_RAMP_DOWN_RAD, .group_id = GROUP_CONTROL, .name = "jump_ramp_down", .value = 0.08f, .min_val = 0.01f, .max_val = 0.5f, .flags = PARAM_FLAG_PERSISTENT, .on_change = nullptr},
{.id = PARAM_JUMP_OMEGA_MAX, .group_id = GROUP_CONTROL, .name = "jump_omega_max", .value = 40.0f, .min_val = 5.0f, .max_val = 200.0f, .flags = PARAM_FLAG_PERSISTENT, .on_change = nullptr},
{.id = PARAM_JUMP_HARDSTOP_MARGIN, .group_id = GROUP_CONTROL, .name = "jump_hs_margin", .value = 0.06f, .min_val = 0.01f, .max_val = 0.5f, .flags = PARAM_FLAG_PERSISTENT, .on_change = nullptr},
{.id = PARAM_JUMP_KP, .group_id = GROUP_CONTROL, .name = "jump_kp", .value = 80.0f, .min_val = 0.0f, .max_val = 500.0f, .flags = PARAM_FLAG_PERSISTENT, .on_change = nullptr},
{.id = PARAM_JUMP_KD, .group_id = GROUP_CONTROL, .name = "jump_kd", .value = 1.0f, .min_val = 0.0f, .max_val = 5.0f, .flags = PARAM_FLAG_PERSISTENT, .on_change = nullptr},
{.id = PARAM_JUMP_EXTEND_KD, .group_id = GROUP_CONTROL, .name = "jump_ext_kd", .value = 0.1f, .min_val = 0.0f, .max_val = 5.0f, .flags = PARAM_FLAG_PERSISTENT, .on_change = nullptr},
{.id = PARAM_JUMP_EXTEND_TIMEOUT_S, .group_id = GROUP_CONTROL, .name = "jump_ext_timeout", .value = 0.15f, .min_val = 0.05f, .max_val = 1.0f, .flags = PARAM_FLAG_PERSISTENT, .on_change = nullptr},
{.id = PARAM_ENABLE_SIM_PITCH_RAD, .group_id = GROUP_CONTROL, .name = "enable_sim_pitch", .value = 0.0f, .min_val = 0.0f, .max_val = 1.0f, .flags = 0, .on_change = nullptr},
{.id = PARAM_SIM_PITCH_RATE_RAD_S, .group_id = GROUP_CONTROL, .name = "sim_pitch_rate", .value = 0.0f, .min_val = -10.0f, .max_val = 10.0f, .flags = 0, .on_change = nullptr},
{.id = PARAM_ENABLE_SIM_PITCH_RATE, .group_id = GROUP_CONTROL, .name = "enable_sim_prate", .value = 0.0f, .min_val = 0.0f, .max_val = 1.0f, .flags = 0, .on_change = nullptr},
{.id = PARAM_PITCH_WATCHDOG_ENABLE, .group_id = GROUP_CONTROL, .name = "pitch_watchdog_en", .value = 1.0f, .min_val = 0.0f, .max_val = 1.0f, .flags = 0, .on_change = nullptr},
{.id = PARAM_LQR_K_PITCH_RET, .group_id = GROUP_CONTROL, .name = "lqr_k_pitch_ret", .value = -0.3f, .min_val = -20.0f, .max_val = 0.0f, .flags = PARAM_FLAG_PERSISTENT, .on_change = nullptr},
{.id = PARAM_LQR_K_RATE_RET, .group_id = GROUP_CONTROL, .name = "lqr_k_rate_ret", .value = -0.1f, .min_val = -5.0f, .max_val = 0.0f, .flags = PARAM_FLAG_PERSISTENT, .on_change = nullptr},
{.id = PARAM_LQR_K_PITCH_EXT, .group_id = GROUP_CONTROL, .name = "lqr_k_pitch_ext", .value = -0.3f, .min_val = -15.0f, .max_val = 0.0f, .flags = PARAM_FLAG_PERSISTENT, .on_change = nullptr},
{.id = PARAM_LQR_K_RATE_EXT, .group_id = GROUP_CONTROL, .name = "lqr_k_rate_ext", .value = -0.1f, .min_val = -5.0f, .max_val = 0.0f, .flags = PARAM_FLAG_PERSISTENT, .on_change = nullptr},
{.id = PARAM_LQR_K_VEL, .group_id = GROUP_CONTROL, .name = "lqr_k_vel", .value = -0.007f, .min_val = -1.0f, .max_val = 0.0f, .flags = PARAM_FLAG_PERSISTENT, .on_change = nullptr},
{.id = PARAM_RUNNING_WHEEL_BYPASS_EN, .group_id = GROUP_CONTROL, .name = "run_wheel_bypass_en", .value = 0.0f, .min_val = 0.0f, .max_val = 1.0f, .flags = 0, .on_change = nullptr},
{.id = PARAM_ALPHA_FORCE_RETRACTED_EN, .group_id = GROUP_CONTROL, .name = "alpha_force_ret_en", .value = 0.0f, .min_val = 0.0f, .max_val = 1.0f, .flags = PARAM_FLAG_PERSISTENT, .on_change = nullptr},
{.id = PARAM_GUI_MOTION_CTRL_EN, .group_id = GROUP_CONTROL, .name = "gui_motion_ctrl_en", .value = 0.0f, .min_val = 0.0f, .max_val = 1.0f, .flags = 0, .on_change = nullptr},
{.id = PARAM_STANDUP_ENABLE, .group_id = GROUP_CONTROL, .name = "standup_enable", .value = 0.0f, .min_val = 0.0f, .max_val = 1.0f, .flags = PARAM_FLAG_PERSISTENT, .on_change = nullptr},
{.id = PARAM_STANDUP_MAX_PITCH_FWD_RAD, .group_id = GROUP_CONTROL, .name = "standup_pitch_fwd", .value = 0.6f, .min_val = 0.0f, .max_val = 1.4f, .flags = PARAM_FLAG_PERSISTENT, .on_change = nullptr},
{.id = PARAM_STANDUP_MAX_PITCH_BWD_RAD, .group_id = GROUP_CONTROL, .name = "standup_pitch_bwd", .value = 0.6f, .min_val = 0.0f, .max_val = 1.4f, .flags = PARAM_FLAG_PERSISTENT, .on_change = nullptr},
{.id = PARAM_STANDUP_CROUCH_KP, .group_id = GROUP_CONTROL, .name = "standup_crouch_kp", .value = 80.0f, .min_val = 0.0f, .max_val = 500.0f, .flags = PARAM_FLAG_PERSISTENT, .on_change = nullptr},
{.id = PARAM_STANDUP_CROUCH_KD, .group_id = GROUP_CONTROL, .name = "standup_crouch_kd", .value = 1.0f, .min_val = 0.0f, .max_val = 5.0f, .flags = PARAM_FLAG_PERSISTENT, .on_change = nullptr},
{.id = PARAM_STANDUP_CROUCH_TIME_S, .group_id = GROUP_CONTROL, .name = "standup_crouch_time", .value = 0.3f, .min_val = 0.05f, .max_val = 2.0f, .flags = PARAM_FLAG_PERSISTENT, .on_change = nullptr},
{.id = PARAM_STANDUP_K_PITCH, .group_id = GROUP_CONTROL, .name = "standup_k_pitch", .value = 0.0f, .min_val = 0.0f, .max_val = 60.0f, .flags = PARAM_FLAG_PERSISTENT, .on_change = nullptr},
{.id = PARAM_STANDUP_K_RATE, .group_id = GROUP_CONTROL, .name = "standup_k_rate", .value = 0.0f, .min_val = 0.0f, .max_val = 15.0f, .flags = PARAM_FLAG_PERSISTENT, .on_change = nullptr},
{.id = PARAM_STANDUP_TORQUE_LIMIT, .group_id = GROUP_CONTROL, .name = "standup_torque_lim", .value = 0.0f, .min_val = 0.0f, .max_val = 7.0f, .flags = PARAM_FLAG_PERSISTENT, .on_change = nullptr},
{.id = PARAM_STANDUP_WHEEL_VEL_LIMIT_TURNS_S, .group_id = GROUP_CONTROL, .name = "standup_vel_limit", .value = 3.0f, .min_val = 1.0f, .max_val = 20.0f, .flags = PARAM_FLAG_PERSISTENT, .on_change = nullptr},
{.id = PARAM_STANDUP_CAPTURE_PITCH_RAD, .group_id = GROUP_CONTROL, .name = "standup_cap_pitch", .value = 0.12f, .min_val = 0.02f, .max_val = 0.4f, .flags = PARAM_FLAG_PERSISTENT, .on_change = nullptr},
{.id = PARAM_STANDUP_CAPTURE_RATE_RADS, .group_id = GROUP_CONTROL, .name = "standup_cap_rate", .value = 1.0f, .min_val = 0.1f, .max_val = 5.0f, .flags = PARAM_FLAG_PERSISTENT, .on_change = nullptr},
{.id = PARAM_STANDUP_CAPTURE_HOLD_S, .group_id = GROUP_CONTROL, .name = "standup_cap_hold", .value = 0.15f, .min_val = 0.02f, .max_val = 1.0f, .flags = PARAM_FLAG_PERSISTENT, .on_change = nullptr},
{.id = PARAM_STANDUP_ATTEMPT_TIMEOUT_S, .group_id = GROUP_CONTROL, .name = "standup_timeout", .value = 1.5f, .min_val = 0.2f, .max_val = 5.0f, .flags = PARAM_FLAG_PERSISTENT, .on_change = nullptr},
{.id = PARAM_STANDUP_MAX_RETRIES, .group_id = GROUP_CONTROL, .name = "standup_max_retries", .value = 2.0f, .min_val = 0.0f, .max_val = 10.0f, .flags = PARAM_FLAG_PERSISTENT, .on_change = nullptr},
{.id = PARAM_STANDUP_RETRY_PAUSE_S, .group_id = GROUP_CONTROL, .name = "standup_retry_pause", .value = 0.3f, .min_val = 0.0f, .max_val = 3.0f, .flags = PARAM_FLAG_PERSISTENT, .on_change = nullptr},
{.id = PARAM_LQR_PITCH_TRIM_RET, .group_id = GROUP_CONTROL, .name = "lqr_pitch_trim_ret", .value = -0.14f, .min_val = -0.3491f, .max_val = 0.3491f, .flags = PARAM_FLAG_PERSISTENT, .on_change = nullptr},
{.id = PARAM_LQR_PITCH_TRIM_EXT, .group_id = GROUP_CONTROL, .name = "lqr_pitch_trim_ext", .value = 0.0f, .min_val = -0.3491f, .max_val = 0.3491f, .flags = PARAM_FLAG_PERSISTENT, .on_change = nullptr},
{.id = PARAM_VEL_PI_THETA_MAX_FWD_RET, .group_id = GROUP_CONTROL, .name = "theta_max_fwd_ret", .value = 0.5235988f, .min_val = 0.1f, .max_val = 0.6981317f, .flags = PARAM_FLAG_PERSISTENT, .on_change = nullptr},
{.id = PARAM_VEL_PI_THETA_MAX_BWD_RET, .group_id = GROUP_CONTROL, .name = "theta_max_bwd_ret", .value = 0.1745329f, .min_val = 0.1f, .max_val = 0.6981317f, .flags = PARAM_FLAG_PERSISTENT, .on_change = nullptr},
{.id = PARAM_VEL_PI_THETA_MAX_FWD_EXT, .group_id = GROUP_CONTROL, .name = "theta_max_fwd_ext", .value = 0.5235988f, .min_val = 0.1f, .max_val = 0.6981317f, .flags = PARAM_FLAG_PERSISTENT, .on_change = nullptr},
{.id = PARAM_VEL_PI_THETA_MAX_BWD_EXT, .group_id = GROUP_CONTROL, .name = "theta_max_bwd_ext", .value = 0.1745329f, .min_val = 0.1f, .max_val = 0.6981317f, .flags = PARAM_FLAG_PERSISTENT, .on_change = nullptr},
{.id = PARAM_PITCH_WATCHDOG_FWD_RET, .group_id = GROUP_CONTROL, .name = "pitch_wd_fwd_ret", .value = 0.6981317f, .min_val = 0.0f, .max_val = 1.4f, .flags = PARAM_FLAG_PERSISTENT, .on_change = nullptr},
{.id = PARAM_PITCH_WATCHDOG_BWD_RET, .group_id = GROUP_CONTROL, .name = "pitch_wd_bwd_ret", .value = 0.2617994f, .min_val = 0.0f, .max_val = 1.4f, .flags = PARAM_FLAG_PERSISTENT, .on_change = nullptr},
{.id = PARAM_PITCH_WATCHDOG_FWD_EXT, .group_id = GROUP_CONTROL, .name = "pitch_wd_fwd_ext", .value = 0.6981317f, .min_val = 0.0f, .max_val = 1.4f, .flags = PARAM_FLAG_PERSISTENT, .on_change = nullptr},
{.id = PARAM_PITCH_WATCHDOG_BWD_EXT, .group_id = GROUP_CONTROL, .name = "pitch_wd_bwd_ext", .value = 0.2617994f, .min_val = 0.0f, .max_val = 1.4f, .flags = PARAM_FLAG_PERSISTENT, .on_change = nullptr},
{.id = PARAM_RADIO_HIP_CMD, .group_id = GROUP_COMMAND, .name = "radio_hip_cmd", .value = 0.0f, .min_val = 0.0f, .max_val = 1.0f, .flags = PARAM_FLAG_READONLY|PARAM_FLAG_COMMAND, .on_change = nullptr},
{.id = PARAM_RADIO_VEL_MAX, .group_id = GROUP_COMMAND, .name = "radio_vel_max", .value = 0.5f, .min_val = 0.0f, .max_val = 2.0f, .flags = PARAM_FLAG_READONLY|PARAM_FLAG_COMMAND, .on_change = nullptr},
{.id = PARAM_RADIO_YAW_MAX, .group_id = GROUP_COMMAND, .name = "radio_yaw_max", .value = 1.0f, .min_val = 0.0f, .max_val = 4.0f, .flags = PARAM_FLAG_READONLY|PARAM_FLAG_COMMAND, .on_change = nullptr},
{.id = PARAM_LIVE_TUNE_CH7_VAL, .group_id = GROUP_COMMAND, .name = "live_tune_ch7_val", .value = 0.0f, .min_val = -2.0f, .max_val = 4.0f, .flags = PARAM_FLAG_READONLY|PARAM_FLAG_COMMAND, .on_change = nullptr},
{.id = PARAM_LIVE_TUNE_CH8_VAL, .group_id = GROUP_COMMAND, .name = "live_tune_ch8_val", .value = 0.0f, .min_val = -1.0f, .max_val = 0.5f, .flags = PARAM_FLAG_READONLY|PARAM_FLAG_COMMAND, .on_change = nullptr},
{.id = PARAM_PROFILE_1_VEL_MAX, .group_id = GROUP_COMMAND, .name = "profile1_vel_max", .value = 0.2f, .min_val = 0.0f, .max_val = 2.0f, .flags = PARAM_FLAG_PERSISTENT, .on_change = nullptr},
{.id = PARAM_PROFILE_1_YAW_MAX, .group_id = GROUP_COMMAND, .name = "profile1_yaw_max", .value = 0.5f, .min_val = 0.0f, .max_val = 4.0f, .flags = PARAM_FLAG_PERSISTENT, .on_change = nullptr},
{.id = PARAM_PROFILE_1_TORQUE_LIM, .group_id = GROUP_COMMAND, .name = "profile1_torque_lim", .value = 0.1f, .min_val = 0.0f, .max_val = 7.0f, .flags = PARAM_FLAG_PERSISTENT, .on_change = nullptr},
{.id = PARAM_PROFILE_2_VEL_MAX, .group_id = GROUP_COMMAND, .name = "profile2_vel_max", .value = 0.5f, .min_val = 0.0f, .max_val = 2.0f, .flags = PARAM_FLAG_PERSISTENT, .on_change = nullptr},
{.id = PARAM_PROFILE_2_YAW_MAX, .group_id = GROUP_COMMAND, .name = "profile2_yaw_max", .value = 1.0f, .min_val = 0.0f, .max_val = 4.0f, .flags = PARAM_FLAG_PERSISTENT, .on_change = nullptr},
{.id = PARAM_PROFILE_2_TORQUE_LIM, .group_id = GROUP_COMMAND, .name = "profile2_torque_lim", .value = 0.2f, .min_val = 0.0f, .max_val = 7.0f, .flags = PARAM_FLAG_PERSISTENT, .on_change = nullptr},
{.id = PARAM_PROFILE_3_VEL_MAX, .group_id = GROUP_COMMAND, .name = "profile3_vel_max", .value = 1.0f, .min_val = 0.0f, .max_val = 2.0f, .flags = PARAM_FLAG_PERSISTENT, .on_change = nullptr},
{.id = PARAM_PROFILE_3_YAW_MAX, .group_id = GROUP_COMMAND, .name = "profile3_yaw_max", .value = 2.0f, .min_val = 0.0f, .max_val = 4.0f, .flags = PARAM_FLAG_PERSISTENT, .on_change = nullptr},
{.id = PARAM_PROFILE_3_TORQUE_LIM, .group_id = GROUP_COMMAND, .name = "profile3_torque_lim", .value = 0.3f, .min_val = 0.0f, .max_val = 7.0f, .flags = PARAM_FLAG_PERSISTENT, .on_change = nullptr},
{.id = PARAM_ACTIVE_PROFILE, .group_id = GROUP_COMMAND, .name = "active_profile", .value = 0.0f, .min_val = 0.0f, .max_val = 2.0f, .flags = PARAM_FLAG_READONLY|PARAM_FLAG_COMMAND, .on_change = nullptr},
{.id = PARAM_LIVE_TUNE_LATCH, .group_id = GROUP_COMMAND, .name = "live_tune_latch", .value = 0.0f, .min_val = 0.0f, .max_val = 1.0f, .flags = PARAM_FLAG_COMMAND, .on_change = nullptr},
{.id = PARAM_ROLL_CTRL_EN, .group_id = GROUP_CONTROL, .name = "roll_ctrl_en", .value = 0.0f, .min_val = 0.0f, .max_val = 1.0f, .flags = PARAM_FLAG_PERSISTENT, .on_change = nullptr},
{.id = PARAM_ROLL_KP, .group_id = GROUP_CONTROL, .name = "roll_kp", .value = 1.0f, .min_val = 0.0f, .max_val = 20.0f, .flags = PARAM_FLAG_PERSISTENT, .on_change = nullptr},
{.id = PARAM_ROLL_KD, .group_id = GROUP_CONTROL, .name = "roll_kd", .value = 0.1f, .min_val = 0.0f, .max_val = 5.0f, .flags = PARAM_FLAG_PERSISTENT, .on_change = nullptr},
{.id = PARAM_ROLL_OFFSET_MAX, .group_id = GROUP_CONTROL, .name = "roll_offset_max", .value = 0.15f, .min_val = 0.0f, .max_val = 0.6f, .flags = PARAM_FLAG_PERSISTENT, .on_change = nullptr},
{.id = PARAM_ROLL_RATE_LIM, .group_id = GROUP_CONTROL, .name = "roll_rate_lim", .value = 0.5f, .min_val = 0.0f, .max_val = 5.0f, .flags = PARAM_FLAG_PERSISTENT, .on_change = nullptr},
{.id = PARAM_ROLL_WATCHDOG_EN, .group_id = GROUP_CONTROL, .name = "roll_watchdog_en", .value = 0.0f, .min_val = 0.0f, .max_val = 1.0f, .flags = PARAM_FLAG_PERSISTENT, .on_change = nullptr},
{.id = PARAM_ROLL_WATCHDOG_LIMIT, .group_id = GROUP_CONTROL, .name = "roll_watchdog_limit", .value = 0.35f, .min_val = 0.0f, .max_val = 1.0f, .flags = PARAM_FLAG_PERSISTENT, .on_change = nullptr},
{.id = PARAM_HIP_ROLL_KP, .group_id = GROUP_HIP, .name = "hip_roll_kp", .value = 3.0f, .min_val = 0.0f, .max_val = 100.0f, .flags = PARAM_FLAG_PERSISTENT, .on_change = nullptr},
{.id = PARAM_HIP_ROLL_KD, .group_id = GROUP_HIP, .name = "hip_roll_kd", .value = 0.5f, .min_val = 0.0f, .max_val = 5.0f, .flags = PARAM_FLAG_PERSISTENT, .on_change = nullptr},
{.id = PARAM_ROLL_CMD_RAD, .group_id = GROUP_COMMAND, .name = "roll_cmd_rad", .value = 0.0f, .min_val = -1.0f, .max_val = 1.0f, .flags = PARAM_FLAG_READONLY|PARAM_FLAG_COMMAND, .on_change = nullptr},
{.id = PARAM_RADIO_ROLL_MAX, .group_id = GROUP_COMMAND, .name = "radio_roll_max", .value = 0.1f, .min_val = 0.0f, .max_val = 0.5f, .flags = PARAM_FLAG_READONLY|PARAM_FLAG_COMMAND, .on_change = nullptr},
{.id = PARAM_PROFILE_1_ROLL_MAX, .group_id = GROUP_COMMAND, .name = "profile1_roll_max", .value = 0.05f, .min_val = 0.0f, .max_val = 0.5f, .flags = PARAM_FLAG_PERSISTENT, .on_change = nullptr},
{.id = PARAM_PROFILE_2_ROLL_MAX, .group_id = GROUP_COMMAND, .name = "profile2_roll_max", .value = 0.1f, .min_val = 0.0f, .max_val = 0.5f, .flags = PARAM_FLAG_PERSISTENT, .on_change = nullptr},
{.id = PARAM_PROFILE_3_ROLL_MAX, .group_id = GROUP_COMMAND, .name = "profile3_roll_max", .value = 0.17f, .min_val = 0.0f, .max_val = 0.5f, .flags = PARAM_FLAG_PERSISTENT, .on_change = nullptr},
